## config/west.yml
```yaml
manifest:
  defaults:
    revision: v0.2
  remotes:
    - name: zmkfirmware
      url-base: https://github.com/zmkfirmware
    - name: urob
      url-base: https://github.com/urob
    - name: eintim
      url-base: https://github.com/eintim
  projects:
    - name: zmk
      remote: zmkfirmware
      import: app/west.yml
    - name: zmk-tri-state
      remote: urob
      revision: main
    - name: zmk-behavior-battery-typer
      remote: eintim
      revision: main
  self:
    path: config
```
